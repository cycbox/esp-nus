## main/Kconfig.projbuild
```kconfig
menu "UART<->BLE Bridge"

    config BRIDGE_BLE_NAME
        string "Advertised BLE device name"
        default "ESP-NUS"

    config BRIDGE_UART_PORT_NUM
        int "UART port number"
        default 0
        range 0 1

    config BRIDGE_UART_BAUD_RATE
        int "UART baud rate"
        default 921600

    config BRIDGE_UART_TX_GPIO
        int "UART TX GPIO"
        default 16

    config BRIDGE_UART_RX_GPIO
        int "UART RX GPIO"
        default 17

    config BRIDGE_UART_FLOW_CTRL
        bool "Enable UART hardware (RTS/CTS) flow control"
        default n
        help
            Strongly recommended at high baud rates to prevent RX overruns when
            the BLE link briefly stalls.

    config BRIDGE_UART_RTS_GPIO
        int "UART RTS GPIO"
        default 6
        depends on BRIDGE_UART_FLOW_CTRL

    config BRIDGE_UART_CTS_GPIO
        int "UART CTS GPIO"
        default 7
        depends on BRIDGE_UART_FLOW_CTRL

    config BRIDGE_UART_RX_BUF_SIZE
        int "UART driver RX buffer size (bytes)"
        default 8192
        help
            Headroom to absorb UART input while the BLE link drains it.

    config BRIDGE_UART_TX_BUF_SIZE
        int "UART driver TX buffer size (bytes)"
        default 8192

    config BRIDGE_UART_RX_CHUNK
        int "UART read chunk size (bytes)"
        default 1024

    config BRIDGE_UART_RX_TIMEOUT_MS
        int "UART read timeout (ms)"
        default 20

    config BRIDGE_BLE_TO_UART_BUF_SIZE
        int "BLE->UART stream buffer size (bytes)"
        default 16384

endmenu
```

## sdkconfig.defaults
```kconfig
CONFIG_IDF_TARGET="esp32c6"
CONFIG_FREERTOS_HZ=1000

CONFIG_BT_ENABLED=y
CONFIG_BT_NIMBLE_ENABLED=y
CONFIG_BT_NIMBLE_ROLE_PERIPHERAL=y
CONFIG_BT_NIMBLE_ROLE_BROADCASTER=y
CONFIG_BT_NIMBLE_ROLE_CENTRAL=n
CONFIG_BT_NIMBLE_ROLE_OBSERVER=n
CONFIG_BT_NIMBLE_MAX_CONNECTIONS=1

CONFIG_BT_BLUEDROID_ENABLED=n
CONFIG_BT_NIMBLE_TRANSPORT_EVT_SIZE=255
CONFIG_BT_NIMBLE_LOG_LEVEL=4
CONFIG_BT_NIMBLE_LOG_LEVEL_NONE=y

CONFIG_BT_NIMBLE_ATT_PREFERRED_MTU=512
CONFIG_BT_NIMBLE_MSYS_1_BLOCK_COUNT=64
CONFIG_BT_NIMBLE_MSYS_1_BLOCK_SIZE=320
CONFIG_BT_NIMBLE_TRANSPORT_ACL_FROM_LL_COUNT=30


CONFIG_ESP_CONSOLE_USB_SERIAL_JTAG=y

CONFIG_BRIDGE_UART_PORT_NUM=0
CONFIG_BRIDGE_UART_TX_GPIO=16
CONFIG_BRIDGE_UART_RX_GPIO=17
```
